## conf/layer.conf
```bitbake
# We have a conf and classes directory, add to BBPATH
BBPATH .= ":${LAYERDIR}"

# We have recipes-* directories, add to BBFILES
BBFILES += "${LAYERDIR}/recipes-*/*/*.bb \
            ${LAYERDIR}/recipes-*/*/*.bbappend"

BBFILE_COLLECTIONS += "meta-audiobox-rt-kernel"
BBFILE_PATTERN_meta-audiobox-rt-kernel = "^${LAYERDIR}/"
BBFILE_PRIORITY_meta-audiobox-rt-kernel = "6"

LAYERDEPENDS_meta-audiobox-rt-kernel = "core"
LAYERSERIES_COMPAT_meta-audiobox-rt-kernel = "dunfell"
```
